## configs/mx6dl-c-sabresd_defconfig
```kconfig
CONFIG_ARM=y
CONFIG_ARCH_MX6=y
CONFIG_TARGET_MX6SABRESD=y
CONFIG_SYS_EXTRA_OPTIONS="IMX_CONFIG=board/freescale/mx6sabresd/mx6dlsabresd.cfg,MX6DL,SYS_USE_SPINOR,MAIN_BOARD_IS_C,CPU_TYPE_IS_DL"
CONFIG_CMD_GPIO=y
```

## configs/mx6q-s3-sabresd_defconfig
```kconfig
CONFIG_ARM=y
CONFIG_ARCH_MX6=y
CONFIG_TARGET_MX6SABRESD=y
CONFIG_SYS_EXTRA_OPTIONS="IMX_CONFIG=board/freescale/mx6sabresd/mx6q_4x_mt41j128.cfg,MX6Q,SYS_USE_SPINOR,MAIN_BOARD_IS_S3,CPU_TYPE_IS_Q"
CONFIG_CMD_GPIO=y
CONFIG_MAIN_BOARD_IS_S3=y
```
